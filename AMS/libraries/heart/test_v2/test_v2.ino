//===============================================================================================OLED Heart Rate
//----------------------------------------Include Library
#include <SPI.h>
#include <Wire.h>
#include <Adafruit_GFX.h>
#include <Adafruit_SSD1306.h>
//----------------------------------------

//----------------------------------------Configure OLED screen size in pixels
#define SCREEN_WIDTH 128 //--> OLED display width, in pixels
#define SCREEN_HEIGHT 64 //--> OLED display height, in pixels
//----------------------------------------

//----------------------------------------Declaration for an SSD1306 display connected to I2C (SDA, SCL pins)
#define OLED_RESET     -1 // Reset pin # (or -1 if sharing Arduino reset pin)
Adafruit_SSD1306 display(SCREEN_WIDTH, SCREEN_HEIGHT, &Wire, OLED_RESET);
//----------------------------------------

//----------------------------------------Variable Declarations
unsigned long previousMillisGetHR = 0; //--> will store the last time Millis (to get Heartbeat) was updated.
unsigned long previousMillisResultHR = 0; //--> will store the last time Millis (to get BPM) was updated.

const long intervalGetHR = 20; //--> Interval for reading heart rate (Heartbeat) = 10ms.
const long intervalResultHR = 10000; //--> The reading interval for the result of the Heart Rate calculation is in 10 seconds.

int PulseSensorSignal; //--> Variable to accommodate the signal value from the sensor
const int PulseSensorHRWire = 0; //--> PulseSensor connected to ANALOG PIN 0 (A0 / ADC 0).
int UpperThreshold = 550; //--> Determine which Signal to "count as a beat", and which to ingore.
int LowerThreshold = 500;

int cntHB = 0; //--> Variable for counting the number of heartbeats.
boolean ThresholdStat = true; //--> Variable for triggers in calculating heartbeats.
int BPMval = 0; //--> Variable to hold the result of heartbeats calculation.

int x = 0; //--> Variable axis x graph values to display on OLED
int y = 0; //--> Variable axis y graph values to display on OLED
int lastx = 0; //--> The graph's last x axis variable value to display on the OLED
int lasty = 0; //--> The graph's last y axis variable value to display on the OLED

int maxSignal = 0;
int minSignal = 1023; // Assuming a 10-bit ADC
//----------------------------------------

//----------------------------------------ams logo
const unsigned char logomedicalstaff [] PROGMEM = {
  0x00, 0x00, 0x00, 0x00, 0x00, 0x00, 0x00, 0x00, 0x00, 0x00, 0x00, 0x00, 0x00, 0x00, 0x00, 0x00,
  0x00, 0x00, 0x00, 0x00, 0x00, 0x00, 0x00, 0x00, 0x00, 0x00, 0x00, 0x00, 0x00, 0x00, 0x00, 0x00,
  0x00, 0x00, 0x00, 0x00, 0x00, 0x00, 0x00, 0x00, 0x00, 0x00, 0x00, 0x00, 0x00, 0x00, 0x00, 0x00,
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  0x00, 0x00, 0x00, 0x00, 0x00, 0x00, 0x00, 0x00, 0x00, 0x00, 0x00, 0x00, 0x00, 0x00, 0x00, 0x00
};
//-------------------------------------------------

//----------------------------------------'Heart_Icon', 16x16px
// I drew this heart icon at : http://dotmatrixtool.com/
const unsigned char Heart_Icon [] PROGMEM = {
  0x00, 0x00, 0x18, 0x30, 0x3c, 0x78, 0x7e, 0xfc, 0xff, 0xfe, 0xff, 0xfe, 0xee, 0xee, 0xd5, 0x56,
  0x7b, 0xbc, 0x3f, 0xf8, 0x1f, 0xf0, 0x0f, 0xe0, 0x07, 0xc0, 0x03, 0x80, 0x01, 0x00, 0x00, 0x00
};
//----------------------------------------

//--------------------------------------------------------------------------------void setup
void setup() {
  Serial.begin(9600); //--> Set's up Serial Communication at certain speed.

  pinMode(2, INPUT); // Setup for leads off detection LO +
  pinMode(3, INPUT); // Setup for leads off detection LO -
  //----------------------------------------SSD1306_SWITCHCAPVCC = generate display voltage from 3.3V internally
  // Address 0x3C for 128x32 and Address 0x3D for 128x64.
  // But on my 128x64 module the 0x3D address doesn't work. What works is the 0x3C address.
  // So please try which address works on your module.
  if (!display.begin(SSD1306_SWITCHCAPVCC, 0x3C)) {
    Serial.println(F("SSD1306 allocation failed"));
    for (;;); //--> Don't proceed, loop forever
  }
  //----------------------------------------

  //----------------------------------------Show initial display buffer contents on the screen
  // the library initializes this with an Adafruit splash screen.
  // display.display();
  // delay(1000);
  //----------------------------------------

  //----------------------------------------Display Bitmap Images
  display.clearDisplay(); //--> for Clearing the display
  display.drawBitmap(0, 0, logomedicalstaff, 128, 64, WHITE); //--> display.drawBitmap(x position, y position, bitmap data, bitmap width, bitmap height, color)
  display.display();
  delay(3500); // Pause for 3 seconds
  //----------------------------------------

  //----------------------------------------Displays BPM value reading information
  display.clearDisplay();
  display.setTextSize(1);
  display.setTextColor(WHITE);

  display.setCursor(0, 12); //--> (x position, y position)
  display.print("     Please wait");

  display.setCursor(0, 22); //--> (x position, y position)
  display.print("     10  seconds");

  display.setCursor(0, 32); //--> (x position, y position)
  display.print("       to get");

  display.setCursor(0, 42); //--> (x position, y position)
  display.print(" the Heart Rate value");

  display.display();
  delay(3000);
  //----------------------------------------

  //----------------------------------------Displays the initial display of BPM value
  display.clearDisplay(); //--> for Clearing the display
  display.drawBitmap(0, 47, Heart_Icon, 16, 16, WHITE); //--> display.drawBitmap(x position, y position, bitmap data, bitmap width, bitmap height, color)

  display.drawLine(0, 43, 127, 43, WHITE); //--> drawLine(x1, y1, x2, y2, color)

  display.setTextSize(2);
  display.setTextColor(WHITE);
  display.setCursor(20, 48); //--> (x position, y position)
  display.print(":0");
  display.display();
  //----------------------------------------

  Serial.println();
  Serial.println("Please wait 10 seconds to get the BPM Value");
}
//--------------------------------------------------------------------------------

//--------------------------------------------------------------------------------void loop
char c = 'n';
void loop() {
  while (c != 'e' && c != 'p')
    if (Serial.available() > 0) {
      c = Serial.read();
      if (c == 'e') {

        display.setTextSize(2);
        display.setTextColor(WHITE);
        display.setCursor(0, 22); //--> (x position, y position)
        display.print("ECG MODE");
        display.drawBitmap(display.getCursorX() + 1, display.getCursorY(), Heart_Icon, 16, 16, WHITE);
        display.display();

      }
    }

  if (c == 'e') {
    if ((digitalRead(2) == 1) || (digitalRead(3) == 1)) {
      Serial.println('0');
    }
    else {
      // send the value of analog input 0:
      Serial.println(analogRead(A1));
    }

    //Wait for a bit to keep serial data from saturating
    delay(1);
  }
  if (c == 'p')
    GetHeartRate(); //--> Calling the GetHeartRate() subroutine
}
//--------------------------------------------------------------------------------

//--------------------------------------------------------------------------------void GetHeartRate()
// This subroutine is for reading the heart rate and calculating it to get the BPM value.
// To get a BPM value based on a heart rate reading for 10 seconds.
void GetHeartRate() {
  //----------------------------------------Process of reading heart rate.
  unsigned long currentMillisGetHR = millis();

  if (currentMillisGetHR - previousMillisGetHR >= intervalGetHR) {
    previousMillisGetHR = currentMillisGetHR;

    PulseSensorSignal = analogRead(PulseSensorHRWire); //--> holds the incoming raw data. Signal value can range from 0-1024

    if (PulseSensorSignal > maxSignal - 5 && ThresholdStat == true) {
      cntHB++;
      ThresholdStat = false;
    }

    if (PulseSensorSignal < minSignal + 5) {
      ThresholdStat = true;
    }

    DrawGraph(); //--> Calling the DrawGraph() subroutine
  }
  //----------------------------------------

  //----------------------------------------The process for getting the BPM value.
  unsigned long currentMillisResultHR = millis();

  if (currentMillisResultHR - previousMillisResultHR >= intervalResultHR) {
    previousMillisResultHR = currentMillisResultHR;

    BPMval = cntHB * 6; //--> The taken heart rate is for 10 seconds. So to get the BPM value, the total heart rate in 10 seconds x 6.
    Serial.print("BPM : ");
    Serial.println(BPMval);

    display.fillRect(20, 48, 108, 18, BLACK);

    display.drawBitmap(0, 47, Heart_Icon, 16, 16, WHITE); //--> display.drawBitmap(x position, y position, bitmap data, bitmap width, bitmap height, color)
    display.drawLine(0, 43, 127, 43, WHITE); //--> drawLine(x1, y1, x2, y2, color)

    display.setTextSize(2);
    display.setTextColor(WHITE);
    display.setCursor(20, 48); //--> (x position, y position)
    display.print(":");
    if (BPMval > 200 || BPMval < 40)
      BPMval = 0;
    display.print(BPMval);
    display.display();

    cntHB = 0;
  }
  //----------------------------------------
}
//--------------------------------------------------------------------------------

//--------------------------------------------------------------------------------Subroutines for drawing or displaying heart rate graphic signals


void DrawGraph() {
  //----------------------------------------Condition to reset the graphic display if it fills the width of the OLED screen
  if (x > 127) {
    display.fillRect(0, 0, 128, 42, BLACK);
    x = 0;
    lastx = 0;
  }
  //----------------------------------------

  //----------------------------------------Process signal data to be displayed on OLED in graphic form
  int ySignal = PulseSensorSignal;

  // Update the maximum and minimum values
  if (ySignal > maxSignal) {
    maxSignal = ySignal;
  }
  if (ySignal < minSignal) {
    minSignal = ySignal;
  }

  int ySignalMap = map(ySignal, minSignal, maxSignal, 0, 40); //--> The y-axis used on OLEDs is from 0 to 40

  y = 40 - ySignalMap;
  //----------------------------------------

  //----------------------------------------Displays the heart rate graph
  if (BPMval == 0)
    display.writeLine(lastx, 20, x, 20, WHITE);
  else
    display.writeLine(lastx, lasty, x, y, WHITE);
  display.display();
  //----------------------------------------

  lastx = x;
  lasty = y;

  x++;

  //----------------------------------------Update the maximum and minimum values after every 128 points
  if (x % 128 == 0) {
    maxSignal = 0;
    minSignal = 1023;
  }
  //----------------------------------------
}
//--------------------------------------------------------------------------------
//===============================================================================================
